## zephyr/Kconfig
```kconfig
menu "FONA"
config DIALER_LOG_LEVEL
	int "Dialer Log Level"
	default 0
config GPIO_LOG_LEVEL
	int "GPIO Log Level"
	default 0
config FLASHING_LIGHT_LOG_LEVEL
	int "Flashing light Log Level"
	default 0
config INTMANAGER_LOG_LEVEL
	int "Intmanager Log Level"
	default 0
config ROTARYDIAL_LOG_LEVEL
	int "Rotarydial Log Level"
	default 0
config BUTTON_LOG_LEVEL
	int "Button Log Level"
	default 0
config CLICKER_LOG_LEVEL
	int "Clicker Log Level"
	default 0
config UART_LOG_LEVEL
	int "Uart Log Level"
	default 0
config GPI_LOG_LEVEL
	int "GPI Log Level"
	default 0
config GPO_LOG_LEVEL
	int "GPO Log Level"
	default 0
endmenu

menu "Zephyr Kernel"
source "$ZEPHYR_BASE/Kconfig.zephyr"
endmenu
```
